## firmware/Kconfig
```kconfig
menu "Rover firmware"

config ROVER_MPU6050
	bool "Rover MPU-6050 IMU driver"
	default y
	depends on DT_HAS_ROVER_MPU6050_ENABLED
	select I2C
	select SENSOR
	help
	  Hand-written I2C driver for MPU-6050 compatible 6-axis IMUs,
	  configured entirely through the device tree.

config ROVER_MPU6050_EMUL
	bool "Rover MPU-6050 I2C emulator"
	default y
	depends on ROVER_MPU6050 && EMUL
	help
	  Register-level emulator used by unit tests on native_sim.


config ROVER_ENCODER
	bool "Rover GPIO quadrature encoder driver"
	default y
	depends on DT_HAS_ROVER_QUAD_ENCODER_ENABLED
	select GPIO

config ROVER_MOTOR
	bool "Rover H-bridge DC motor driver"
	default y
	depends on DT_HAS_ROVER_DC_MOTOR_ENABLED
	select GPIO
	select PWM

endmenu
```

## firmware/dts/bindings/encoder/rover,quad-encoder.yaml
```yaml
description: Quadrature encoder read with GPIO edge interrupts on both channels

compatible: "rover,quad-encoder"

include: base.yaml

properties:
  a-gpios:
    type: phandle-array
    required: true
    description: Channel A input.
  b-gpios:
    type: phandle-array
    required: true
    description: Channel B input.
  counts-per-rev:
    type: int
    required: true
    description: |
      Edge counts per output-shaft revolution with 4x decoding
      (= encoder PPR x gearbox ratio x 4).
  invert:
    type: boolean
    description: Negate the count so forward wheel motion counts up.
```

## firmware/dts/bindings/motor/rover,dc-motor.yaml
```yaml
description: Brushed DC motor behind an H-bridge (PWM enable + two direction pins)

compatible: "rover,dc-motor"

include: base.yaml

properties:
  pwms:
    type: phandle-array
    required: true
    description: PWM channel driving the bridge enable input.
  in1-gpios:
    type: phandle-array
    required: true
  in2-gpios:
    type: phandle-array
    required: true
  deadband-permille:
    type: int
    default: 20
    description: Duty magnitudes below this (1/1000) are treated as zero.
```

## firmware/dts/bindings/sensor/rover,mpu6050.yaml
```yaml
description: MPU-6050 compatible 6-axis IMU, handled by the hand-written rover driver

compatible: "rover,mpu6050"

include: [sensor-device.yaml, i2c-device.yaml]

properties:
  accel-range-g:
    type: int
    default: 2
    enum: [2, 4, 8, 16]
    description: Accelerometer full-scale range in g.

  gyro-range-dps:
    type: int
    default: 250
    enum: [250, 500, 1000, 2000]
    description: Gyroscope full-scale range in degrees per second.

  dlpf-cfg:
    type: int
    default: 3
    enum: [0, 1, 2, 3, 4, 5, 6]
    description: |
      Digital low-pass filter setting (CONFIG register DLPF_CFG).
      0 = 260 Hz gyro bandwidth (8 kHz gyro output rate), 3 = 44 Hz, 6 = 5 Hz.
      Settings 1..6 use a 1 kHz gyro output rate.

  sample-rate-div:
    type: int
    default: 4
    description: |
      SMPLRT_DIV register value. Sample rate = gyro output rate / (1 + div).
      The default of 4 with DLPF enabled gives 200 Hz.

  who-am-i:
    type: int
    default: 0x68
    description: Expected WHO_AM_I register value, checked at init.
```

## firmware/tests/control/testcase.yaml
```yaml
tests:
  rover.lib.control:
    platform_allow:
      - native_sim
    tags: rover control
```

## firmware/tests/faultlog/testcase.yaml
```yaml
tests:
  rover.lib.faultlog:
    platform_allow:
      - native_sim
    tags: rover faultlog
```

## firmware/tests/imu/testcase.yaml
```yaml
tests:
  rover.drivers.imu:
    platform_allow:
      - native_sim
    tags: rover imu
```

## firmware/west.yml
```yaml
manifest:
  # micro-ROS is opt-in: `west config manifest.group-filter -- +microros && west update`
  group-filter: [-microros]
  remotes:
    - name: micro-ros
      url-base: https://github.com/micro-ROS
    - name: zephyrproject-rtos
      url-base: https://github.com/zephyrproject-rtos
  projects:
    - name: zephyr
      remote: zephyrproject-rtos
      revision: v4.4.0
      import:
        name-allowlist:
          - cmsis
          - cmsis_6
          - hal_stm32
          - mcuboot
          - picolibc
          - zephyr-lang-rust
          - zcbor
    - name: micro_ros_zephyr_module
      remote: micro-ros
      revision: rolling
      path: modules/lib/micro_ros_zephyr_module
      groups: [microros]
  self:
    path: firmware
```
